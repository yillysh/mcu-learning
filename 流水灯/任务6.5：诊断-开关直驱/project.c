#include "AI8051U.h"

/* ==================== 6.5 诊断：低边开关直驱测试 ====================
   用途：把「PWM 外设配置」和「功率回路」彻底分开，独立判断故障在哪一侧。

   本诊断不初始化 PWMA，P1.0 就是一路普通推挽 GPIO：
        亮 2s -> 灭 2s -> 循环

   怎么判读：
   ---------------------------------------------------------------
   A) P1.0 对 GND 在 3.3V / 0V 之间来回变
      -> MCU 侧没问题，问题在功率回路（管子/接线/灯串/电压预算）

   B) 灯串跟着一闪一闪
      -> 功率回路是好的！那 6.5 的 PWM 版本不亮就是 PWM 配置问题

   C) P1.0 在变，但量三极管 集电极-发射极(Vce) 一直 ≈15V
      -> 基极/栅极驱动没到管子：基极电阻太大、脚序接错、管子型号不对

   D) Vce 会跟着在 ≈0V / ≈15V 之间变，但灯就是不亮
      -> 灯串开路(有 LED 接反或面包板接触不良)
         或者 灯串总压降 ΣVf 已经超过 15V，根本达不到导通点
   ---------------------------------------------------------------
   注意：本文件只是诊断，不参与 6.5 的正式交付。
   ==================================================================== */

#define ON_MS   2000        /* 导通 2s，给万用表足够时间读数 */
#define OFF_MS  2000        /* 关断 2s */

void delay_ms(unsigned int ms)
{
    unsigned int i;
    while (ms--)
    {
        i = 2500;           /* 约 1ms @40MHz */
        while (--i);
    }
}

void main(void)
{
    P1M0 |= 0x01;           /* P1.0 推挽输出 */
    P1M1 &= ~0x01;

    P10 = 0;                /* 上电先关断 */

    while (1)
    {
        P10 = 1;            /* 基极/栅极高 -> 低边开关导通 */
        delay_ms(ON_MS);

        P10 = 0;            /* 关断 */
        delay_ms(OFF_MS);
    }
}
